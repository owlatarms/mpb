/******************************************************************************
 * @File: main.c
 * @Author: Milandr, L.
 * @Project: #11.2_UART_[Exchange_Via_DMA]
 * @Version: 1.0.1
 * @Compiler: ARM Compiler V5.06 (build 750)
 * @Microcontroller: К1986ВЕ92QI
 * @Device: Отладочная плата «МилКиТЭС»
 * @Date: 30.06.2020
 * @Purpose: Основной модуль
 * @Description:
 * В данном проекте реализованы передача и приём данных по интерфейсу UART
 * с использованием DMA. Передаваемые данные представляют собой некоторую строку;
 * запуск передачи осуществляется по нажатию кнопки. Принимаемые данные записываются
 * в буфер (массив). При обновлении буфера его содержание отображается на дисплей.
 ******************************************************************************/

// Подключение заголовка
#include "main.h"

// Основная функция
int main(void)
{
  // Общая инициализация
  CPU_Init();   // Система тактирования
  TICK_Init();  // Системный таймер
  BTN_Init();   // Кнопки
  LCD_Init();   // ЖК-дисплей

  // Инициализация UART
  UART_Init();

  // Формирование строки для передачи
  strcpy((char*)&UART_TX_BUF, EXAMPLE_STR);

  // Вычисление длины строки (объёма передаваемых данных)
  uint32_t size = strlen((char*)UART_TX_BUF);

  // Основной цикл
  while (true) {

    // Блок работы с передачей данных
    if (Wait(&mark[0], 100) == true) {

      // Обработка кнопки MID
      if (BTN_Handler(BTN_M) == true) {

        // Запуск цикла передач
        while (UART_Transmit(UART_TX_BUF, size) != UART_TRX_INITIATED);
      }
    }

    // Блок работы с приёмом данных
    if (Wait(&mark[1], 250) == true) {

      // Если флаг обновления буфера приёмника установлен...
      if (flg_uart_rx_upd == true) {

        // Сброс флага
        flg_uart_rx_upd = false;

        // Цикл отображения данных (строки 3...6)
        for (int i = 0; i < 4; i++) {
          LCD_PrintString((char*)&UART_RX_BUF[LCD_SCREEN_WIDTH * i], i + 3);
        }
      }
    }
  }
}
