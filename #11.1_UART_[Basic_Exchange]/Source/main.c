/******************************************************************************
 * @File: main.c
 * @Author: Milandr, L.
 * @Project: #11.1_UART_[Simple_Exchange]
 * @Version: 1.0.1
 * @Compiler: ARM Compiler V5.06 (build 750)
 * @Microcontroller: К1986ВЕ92QI
 * @Device: Отладочная плата «МилКиТЭС»
 * @Date: 29.06.2020
 * @Purpose: Основной модуль
 * @Description:
 * В данном проекте реализованы передача и приём данных по интерфейсу UART.
 * Передаваемые данные представляют собой строку цифр 0...9; запуск передачи
 * осуществляет по нажатию кнопки. Принимаемые данные записываются в массив
 * и отображаются на дисплей. Ошибки контроля чётности фиксируются в аппаратном
 * прерывании.
 ******************************************************************************/

// Подключение заголовка
#include "main.h"

// Основная функция
int main(void)
{
  // Общая инициализация
  CPU_Init();   // Система тактирования
  TICK_Init();  // Системный таймер
  BTN_Init();   // Кнопки
  LCD_Init();   // ЖК-дисплей

  // Инициализация UART
  UART_Init();

  // Инициализация переменных
  char rx_data[LCD_SCREEN_WIDTH] = {0};  // Принимаемые данные
  char tx_data[] = EX_STR;               // Передаваемые данные
  int i = 0, j = 0;                      // Итераторы циклов

  // Отображение исходного значения счётчика ошибок контроля чётности
  LCD_PrintString("       PE = %u", 5, parity_error);

  // Основной цикл
  while (true) {

    // Блок работы с передачей данных
    if (Wait(&mark[0], 100) == true) {

      // Обработка кнопки MID
      if (BTN_Handler(BTN_M) == true) {

        // Передача данных
        MDR_UART2->DR = tx_data[i];

        // Переход к следующему элементу
        i = (i + 1) % sizeof(EX_STR);
      }
    }

    // Блок работы с приёмом данных
    if (Wait(&mark[1], 100) == true) {

      // Пока буфер приёмника не пуст...
      while ((MDR_UART2->FR & UART_FR_RXFE) == 0) {

        // Изъятие данных из буфера приёмника
        rx_data[j] = MDR_UART2->DR;

        // Отображение данных на дисплей
        LCD_PrintSymbol(rx_data[j], j, 3);

        // Переход к следующему элементу
        j = (j + 1) % LCD_SCREEN_WIDTH;
      }

      // Отображение значения счётчика ошибок контроля чётности
      LCD_PrintString("       PE = %u", 5, parity_error);
    }
  }
}
